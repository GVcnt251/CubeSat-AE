## firmware/main/Kconfig.projbuild
```kconfig
menu "Cubo"

    config CUBE_WIFI_SSID
        string "Wi-Fi SSID"
        default "cubo"

    config CUBE_WIFI_PASS
        string "Wi-Fi password"
        default "changeme123"

    config CUBE_GS_PORT
        int "Cube UDP port"
        default 5000

    config CUBE_CAM_LATENCY_MS
        int "Camera latency (ms)"
        default 80
        help
          Time between image capture and delivery to the control core.
          Measure this value on hardware.

    config CUBE_WHEEL_FAKE
        bool "Simulated wheels (without motors or CAN)"
        default y
        help
          Simulate wheel responses in software.
          Disable this option to communicate with real motors over CAN-FD.

    config CUBE_MOTEUS_ID_X
        int "X wheel CAN ID (0 = not configured)"
        range 0 127
        default 0
        help
          Actual CAN ID of the motor assigned to body axis X.
          Zero means that this wheel is not configured.

    config CUBE_MOTEUS_ID_Y
        int "Y wheel CAN ID (0 = not configured)"
        range 0 127
        default 0
        help
          Actual CAN ID of the motor assigned to body axis Y.
          Zero means that this wheel is not configured.

    config CUBE_MOTEUS_ID
        int "Z wheel CAN ID"
        range 1 127
        default 1
        help
          Existing motor ID, retained for compatibility.
          Confirm its physical assignment to body axis Z before testing.

    config CUBE_WHEEL_SIGN_X
        int "X wheel direction (+1 or -1)"
        range -1 1
        default 1
        help
          Only +1 and -1 are valid. Must be verified on hardware.
          The driver rejects zero.

    config CUBE_WHEEL_SIGN_Y
        int "Y wheel direction (+1 or -1)"
        range -1 1
        default 1
        help
          Only +1 and -1 are valid. Must be verified on hardware.
          The driver rejects zero.

    config CUBE_WHEEL_SIGN
        int "Z wheel direction (+1 or -1)"
        range -1 1
        default 1
        help
          Existing wheel direction, retained for compatibility.
          Only +1 and -1 are valid. Must be verified on hardware.
          The driver rejects zero.

endmenu
```
